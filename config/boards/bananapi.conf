## patch/lab/u-boot/bananapim4zero/sram-supervisor/bananapi_m4zero_supervisor_defconfig
```kconfig
CONFIG_ARM=y
CONFIG_ARCH_SUNXI=y
CONFIG_MACH_SUN50I_H616=y
CONFIG_DEFAULT_DEVICE_TREE=""
CONFIG_SPL=y
CONFIG_BPI_SRAM_SUPERVISOR=y
CONFIG_SPL_LDSCRIPT="arch/arm/mach-sunxi/supervisor.lds"
CONFIG_SPL_MAX_SIZE=0xffa0
CONFIG_SPL_STACK=0x58000
CONFIG_SPL_BSS_START_ADDR=0x48010
CONFIG_SPL_BSS_MAX_SIZE=0x7fe0
# CONFIG_SPL_STACK_R is not set
CONFIG_SPL_SYS_MALLOC_F_LEN=0x2000
# CONFIG_SPL_BANNER_PRINT is not set
# CONFIG_SPL_ATF is not set
# CONFIG_SPL_LOAD_FIT is not set
# CONFIG_SPL_FIT is not set
# CONFIG_SPL_OF_CONTROL is not set
# CONFIG_SPL_DM is not set
# CONFIG_SPL_DM_SERIAL is not set
# CONFIG_SPL_DM_MMC is not set
# CONFIG_SPL_BLK is not set
# CONFIG_SPL_ENV_SUPPORT is not set
# CONFIG_SPL_LOG is not set
# CONFIG_SPL_MMC_WRITE is not set
# CONFIG_SPL_FS_FAT is not set
# CONFIG_SPL_FS_EXT4 is not set
# CONFIG_SPL_RAW_IMAGE_SUPPORT is not set
# CONFIG_SPL_LEGACY_IMAGE_FORMAT is not set
CONFIG_SPL_MMC=y
CONFIG_MMC_SUNXI_SLOT_EXTRA=-1
# CONFIG_SUPPORT_EMMC_BOOT is not set
CONFIG_SPL_SERIAL=y
CONFIG_SPL_YMODEM_SUPPORT=y
CONFIG_CMD_LOADXY_TIMEOUT=30
CONFIG_SPL_CRC32=y
CONFIG_SPL_SHA256=y
CONFIG_SPL_LIBCOMMON_SUPPORT=y
CONFIG_SPL_LIBGENERIC_SUPPORT=y
CONFIG_SPL_SYS_MALLOC_SIMPLE=y
CONFIG_SYS_MALLOC_F_LEN=0x2000
# CONFIG_SPL_I2C is not set
# CONFIG_AXP305_POWER is not set
# CONFIG_SPL_POWER is not set
# CONFIG_SPL_SPI is not set
# CONFIG_SPL_SPI_SUNXI is not set
# CONFIG_SPL_WDT is not set
# CONFIG_SPL_WATCHDOG is not set
# CONFIG_SPL_BOOTSTAGE is not set
# CONFIG_SPL_OF_LIBFDT is not set
# CONFIG_SPL_PARTITIONS is not set
# CONFIG_SPL_SYS_MALLOC is not set
CONFIG_LOCALVERSION="-bpi-sram-p2"
# CONFIG_LOCALVERSION_AUTO is not set
```
