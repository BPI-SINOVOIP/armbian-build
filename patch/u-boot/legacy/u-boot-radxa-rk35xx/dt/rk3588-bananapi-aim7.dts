// SPDX-License-Identifier: (GPL-2.0+ OR MIT)

/dts-v1/;

#include "rk3588-armsom-aim7-io.dts"

/ {
	model = "Banana Pi AIM7";
	compatible = "bananapi,bpi-aim7", "armsom,aim7-io", "rockchip,rk3588";
};
